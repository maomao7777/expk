## package/net/frameworkd/Config.in
```kconfig
menuconfig BR2_PACKAGE_FRAMEWORKD
    bool "framework_demoon"
    help
        Support frameworkd package
if BR2_PACKAGE_FRAMEWORKD
config BR2_PACKAGE_FRAMEWORKD_TBD
    string "TBD"
    default "7777"
endif
```

## package/net/testkmod/Config.in
```kconfig
menuconfig BR2_PACKAGE_TESTKMOD
    bool "test_kmod"
    help
        Support test kernel module package
```
